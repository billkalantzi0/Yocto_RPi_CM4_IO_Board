## conf/bblayers.conf.sample
```bitbake
# bblayers.conf.sample (CM4 layers configuration)

LCONF_VERSION = "7"

BBPATH = "${TOPDIR}"
BBFILES ?= ""

BBLAYERS ?= " \
  ${TOPDIR}/../poky/meta \
  ${TOPDIR}/../poky/meta-poky \
  ${TOPDIR}/../poky/meta-yocto-bsp \
  ${TOPDIR}/../meta-raspberrypi \
"
```

## conf/local.conf.sample
```bitbake
# local.conf.sample (Yocto CM4, full hardware enabled, 64-bit)

MACHINE ??= "raspberrypi4-64"

DISTRO ?= "poky"
PACKAGE_CLASSES ?= "package_ipk"
EXTRA_IMAGE_FEATURES ?= "debug-tweaks ssh-server-openssh"

# CM4 IO Board Hardware Features Enabled
ENABLE_UART = "1"
ENABLE_SPI_BUS = "1"
ENABLE_I2C = "1"
ENABLE_GPIO = "1"
ENABLE_PCIE = "1"
ENABLE_USBHOST = "1"
ENABLE_ETHERNET = "1"
ENABLE_VC4GRAPHICS = "1"

# Include important kernel modules and hardware firmware
IMAGE_INSTALL_append = " kernel-modules linux-firmware-rpidistro-bcm43455 bluez5 i2c-tools spi-tools usbutils pciutils"

# Disk monitoring safety limits
BB_DISKMON_DIRS ??= "\
    STOPTASKS,${TMPDIR},1G,100K \
    STOPTASKS,${DL_DIR},1G,100K \
    STOPTASKS,${SSTATE_DIR},1G,100K \
    STOPTASKS,/tmp,100M,100K \
    HALT,${TMPDIR},100M,1K \
    HALT,${DL_DIR},100M,1K \
    HALT,${SSTATE_DIR},100M,1K \
    HALT,/tmp,10M,1K"

CONF_VERSION = "1"
```

## meta-rpi/conf/layer.conf
```bitbake
# conf/layer.conf
BBPATH .= ":${LAYERDIR}"

BBFILES += "${LAYERDIR}/recipes-*/*/*.bb \
            ${LAYERDIR}/recipes-*/*/*.bbappend"

BBFILE_COLLECTIONS += "meta-rpi"
BBFILE_PATTERN_meta-rpi = "^${LAYERDIR}/"
BBFILE_PRIORITY_meta-rpi = "5"

LAYERSERIES_COMPAT_meta-rpi = "nanbield scarthgap kirkstone mickledore"
```
